// esp32.ino
// TinyGen firmware for the esp32-s2 mini.
// loads int8 cvae weights from SPIFFS into PSRAM at boot, serves a little
// website, and draws 32x32 clothing pictures when you ask it to.
// everything (rng, math, web server) lives in this one file because i gave
// up on project structure halfway through and never went back.

#include <WiFi.h>
#include <ESPmDNS.h>
#include <ESPAsyncWebServer.h>
#include <SPIFFS.h>
#include <math.h>
#include <string.h>

#include "freertos/FreeRTOS.h"
#include "freertos/task.h"
#include "esp_task_wdt.h"
#include "esp_random.h"      // hardware noise rng, the star of the show
#include "soc/rtc_cntl_reg.h"

#include "model_meta.h"      // generated by export_model.py, don't edit
#include "index_html.h"      // the entire website inlined. sorry

// put your wifi credentials.
const char* WIFI_SSID = "wifi_ssid";
const char* WIFI_PASS = "wifi_pass";
const char* MDNS_NAME = "tinygen";

AsyncWebServer server(80);
AsyncWebSocket ws("/ws");

// how much of the class prototype to keep vs how much fresh noise to add.
// every image looks the same?  more noise / less mix.
// images look like static?    less noise / more mix.
#define Z_CLASS_MIX 0.50f
#define Z_NOISE_STD 0.80f

// ---- rng ----
// esp_random() is true hardware noise but i need a smooth stream of floats,
// so i seed a pcg32 with it and pull from that. best of both worlds.
static uint64_t rng_state = 0;
static uint32_t rng_inc   = 1;
static uint32_t last_seed = 0;

uint32_t rng_next() {   // pcg32, copied from the paper years ago, never questioned since
    uint64_t old = rng_state;
    rng_state = old * 6364136223846793005ULL + rng_inc;
    uint32_t xsh = (uint32_t)(((old >> 18u) ^ old) >> 27u);
    uint32_t rot = (uint32_t)(old >> 59u);
    return (xsh >> rot) | (xsh << ((-rot) & 31));
}

uint32_t rng_seed() {
    // hardware noise xor'd with uptime, so even two boots in the same
    // millisecond won't repeat a sequence
    uint32_t hw = esp_random();
    uint32_t t  = (uint32_t)micros();
    last_seed = hw ^ (t * 2654435761u);
    rng_inc   = esp_random() | 1u;          // has to be odd, pcg rules
    rng_state = (((uint64_t)hw << 32) | (uint64_t)t) + rng_inc;
    for (int i = 0; i < 8; i++) rng_next(); // throw the first few away, feels right
    return last_seed;
}

float rng_uniform() {  // [0,1)
    return (float)(rng_next() >> 8) * (1.0f / 16777216.0f);
}

float rng_gauss() {    // box-muller, same distribution the model trained on
    float u1 = rng_uniform() + 1e-7f;       // keep log() away from zero
    float u2 = rng_uniform();
    return sqrtf(-2.0f * logf(u1)) * cosf(6.28318530718f * u2);
}

// ---- globals shared between the websocket and the inference task ----
// fixed sizes on purpose: no malloc anywhere near the hot path
char hex_buf[2050];    // 1024 pixels * 2 hex chars + terminator
char json_buf[2200];   // hex plus json wrapper, measured once, never again

volatile bool want_image = false;  // websocket sets it, inference task clears it
int wanted_class = 0;

// conv scratch in internal sram. psram is way too slow for the inner loop;
// this little ~21kb tile is the difference between 30s and 300s per image
#define SCR_IN_FLOATS  4096
#define SCR_ACC_FLOATS 1024
#define SCR_W_FLOATS   360
static float scr_in[SCR_IN_FLOATS]   DRAM_ATTR;
static float scr_acc[SCR_ACC_FLOATS] DRAM_ATTR;
static float scr_w[SCR_W_FLOATS]     DRAM_ATTR;

// ---- int8 weights, read straight from the bin file ----
// layout has to match export_model.py byte for byte or nothing works
struct LayerInfo { float scale; int8_t zero_point; int size; int8_t* data; };
LayerInfo layers[NUM_WEIGHT_LAYERS];
bool model_loaded = false;

inline float get_w(int layer_idx, int index) {
    return (float)layers[layer_idx].data[index] * layers[layer_idx].scale;
}

// activation buffers, allocated once in setup. sizes come straight from the
// network geometry - change channels in the trainer, change them here too
float* buf_feat4; float* buf_up8; float* buf_feat8;
float* buf_up16; float* buf_feat16; float* buf_up32;
float* buf_feat32; float* buf_refined; float* buf_logits;
float* buf_film1; float* buf_film2; float* buf_film3;
float z_vec[32];         // the sampled latent for this generation
uint8_t out_img[1024];   // final 32x32 class indices

bool load_model() {
    File f = SPIFFS.open("/model_weights.bin", "r");
    if (!f) return false;
    uint32_t num_layers; f.read((uint8_t*)&num_layers, 4);
    if (num_layers != NUM_WEIGHT_LAYERS) { f.close(); return false; }  // wrong bin, bail
    for (int i = 0; i < num_layers; i++) f.read((uint8_t*)&layers[i].scale, 4);
    for (int i = 0; i < num_layers; i++) f.read((uint8_t*)&layers[i].zero_point, 1);
    for (int i = 0; i < num_layers; i++) f.read((uint8_t*)&layers[i].size, 4);
    for (int i = 0; i < num_layers; i++) {
        layers[i].data = (int8_t*)ps_malloc(layers[i].size);
        if (!layers[i].data) { f.close(); return false; }
        f.read((uint8_t*)layers[i].data, layers[i].size);
    }
    f.close();
    return true;
}

// ---- nn kernels ----
// every one of these sprinkles in taskYIELD()/vTaskDelay() calls. without them
// the wifi stack starves and the chip watchdog-reboots mid-picture. ask me how
// i know.

void linear_fwd(float* out, const float* in, int layer_w, int layer_b, int in_d, int out_d) {
    for (int o = 0; o < out_d; o++) {
        float s = get_w(layer_b, o);
        int w_offset = o * in_d;
        for (int i = 0; i < in_d; i++) s += in[i] * get_w(layer_w, w_offset + i);
        out[o] = s;
        if ((o & 31) == 0) taskYIELD();
        if ((o & 255) == 0) vTaskDelay(1);
    }
}

void relu_ip(float* d, int n) {
    for (int i = 0; i < n; i++) if (d[i] < 0.0f) d[i] = 0.0f;
    taskYIELD();
}

void upsample_2x(float* out, const float* in, int C, int H, int W) {
    int OH = H * 2, OW = W * 2;
    for (int c = 0; c < C; c++) {
        for (int y = 0; y < H; y++) for (int x = 0; x < W; x++) {
            float v = in[c * H * W + y * W + x];
            int oy = y * 2, ox = x * 2;
            out[c*OH*OW + oy*OW + ox] = v; out[c*OH*OW + oy*OW + ox+1] = v;
            out[c*OH*OW + (oy+1)*OW + ox] = v; out[c*OH*OW + (oy+1)*OW + ox+1] = v;
        }
        if ((c & 15) == 0) taskYIELD();
    }
    vTaskDelay(1);
}

// the tiled one. copies a padded input tile + a weight tile into sram scratch
// and runs the 3x3 loop entirely from there. no bounds checks inside thanks
// to the padding baked in at copy time.
void conv3x3_fast(float* out, const float* in, int layer_w, int layer_b,
                  int ic, int oc, int H, int Wp) {
    int sp = H * Wp;
    int Hp = H + 2, Wpd = Wp + 2;
    int maxT = SCR_IN_FLOATS / (Hp * Wpd);   // how many channels fit in scratch
    if (maxT < 1) maxT = 1;
    int T = (ic < maxT) ? ic : maxT;

    for (int o = 0; o < oc; o++) {           // seed output with bias
        float b = get_w(layer_b, o);
        for (int i = 0; i < sp; i++) out[o * sp + i] = b;
        if ((o & 15) == 0) taskYIELD();
    }

    for (int o = 0; o < oc; o++) {
        for (int c0 = 0; c0 < ic; c0 += T) {
            int cn = ic - c0; if (cn > T) cn = T;

            float wscale = layers[layer_w].scale;
            for (int c = 0; c < cn; c++) {
                const int8_t* wp = &layers[layer_w].data[(o * ic + c0 + c) * 9];
                for (int k = 0; k < 9; k++) scr_w[c * 9 + k] = (float)wp[k] * wscale;
            }

            for (int c = 0; c < cn; c++) {   // padded copy psram -> sram
                const float* src = &in[(c0 + c) * sp];
                float* dst = &scr_in[c * Hp * Wpd];
                for (int y = 0; y < Hp; y++) {
                    int sy = y - 1;
                    for (int x = 0; x < Wpd; x++) {
                        int sx = x - 1;
                        dst[y * Wpd + x] =
                            (sy >= 0 && sy < H && sx >= 0 && sx < Wp) ? src[sy * Wp + sx] : 0.0f;
                    }
                }
            }

            for (int i = 0; i < sp; i++) scr_acc[i] = out[o * sp + i];

            for (int c = 0; c < cn; c++) {   // hot loop, pure sram
                const float* t = &scr_in[c * Hp * Wpd];
                const float* w9 = &scr_w[c * 9];
                for (int y = 0; y < H; y++) {
                    const float* r0 = &t[y * Wpd];
                    const float* r1 = r0 + Wpd;
                    const float* r2 = r1 + Wpd;
                    float* a = &scr_acc[y * Wp];
                    for (int x = 0; x < Wp; x++) {
                        a[x] += r0[x]   * w9[0] + r0[x+1] * w9[1] + r0[x+2] * w9[2]
                              + r1[x]   * w9[3] + r1[x+1] * w9[4] + r1[x+2] * w9[5]
                              + r2[x]   * w9[6] + r2[x+1] * w9[7] + r2[x+2] * w9[8];
                    }
                }
            }

            for (int i = 0; i < sp; i++) out[o * sp + i] = scr_acc[i];
            taskYIELD();
        }
        vTaskDelay(1);
    }
}

void conv1x1_fast(float* out, const float* in, int layer_w, int layer_b,
                  int ic, int oc, int H, int Wp) {
    int sp = H * Wp;
    for (int o = 0; o < oc; o++) {
        float b = get_w(layer_b, o);
        for (int i = 0; i < sp; i++) out[o * sp + i] = b;
    }
    for (int o = 0; o < oc; o++) {
        float* d = &out[o * sp];
        for (int c = 0; c < ic; c++) {
            float w = get_w(layer_w, o * ic + c);
            const float* s = &in[c * sp];
            for (int i = 0; i < sp; i++) d[i] += s[i] * w;
        }
        taskYIELD();
        if ((o & 7) == 0) vTaskDelay(1);
    }
}

void groupnorm_ip(float* d, int C, int H, int Wp, int groups, int layer_gamma, int layer_beta) {
    int sp = H * Wp; int cpg = C / groups;
    for (int g = 0; g < groups; g++) {
        float sum = 0.0f, sum_sq = 0.0f; int count = cpg * sp;
        for (int c = g * cpg; c < (g + 1) * cpg; c++)
            for (int i = 0; i < sp; i++) { float v = d[c * sp + i]; sum += v; sum_sq += v * v; }
        float mean = sum / count;
        float var = (sum_sq / count) - (mean * mean);
        float inv_std = 1.0f / sqrtf(var + 1e-5f);
        for (int c = g * cpg; c < (g + 1) * cpg; c++) {
            float w = get_w(layer_gamma, c); float b = get_w(layer_beta, c);
            for (int i = 0; i < sp; i++) d[c * sp + i] = (d[c * sp + i] - mean) * inv_std * w + b;
        }
        taskYIELD();
    }
    vTaskDelay(1);
}

// film: per-channel scale+shift predicted from the condition vector.
// the 0.1 keeps it gentle at the start of training, kept here to match.
void film_apply(float* data, const float* gb, int C, int H, int Wp) {
    int sp = H * Wp;
    for (int c = 0; c < C; c++) {
        float scale = 1.0f + 0.1f * gb[c]; float shift = 0.1f * gb[C + c];
        for (int i = 0; i < sp; i++) data[c * sp + i] = data[c * sp + i] * scale + shift;
    }
    taskYIELD();
}

void argmax_ch(uint8_t* out, const float* logits, int C, int H, int W) {
    int sp = H * W;
    for (int i = 0; i < sp; i++) {
        float mx = logits[i]; uint8_t mi = 0;
        for (int c = 1; c < C; c++) { float v = logits[c * sp + i]; if (v > mx) { mx = v; mi = c; } }
        out[i] = mi;
    }
}

// ---- decoder ----
// the numbers below are tensor positions inside model_weights.bin
// (0 = class_embed ... 27 = class_latents), names live in model_meta.h
void decoder_forward(uint8_t* output_image, const float* latent_z, int class_idx) {
    unsigned long t0 = millis();
    float emb[16]; for (int i = 0; i < 16; i++) emb[i] = get_w(0, class_idx * 16 + i);
    float emb_out[16]; linear_fwd(emb_out, emb, 1, 2, 16, 16); relu_ip(emb_out, 16);
    float cond[48]; memcpy(cond, latent_z, 32 * sizeof(float)); memcpy(&cond[32], emb_out, 16 * sizeof(float));

    linear_fwd(buf_feat4, cond, 3, 4, 48, 3072);
    Serial.printf("[nn] proj: %lu ms\n", millis() - t0);

    upsample_2x(buf_up8, buf_feat4, 192, 4, 4);
    conv3x3_fast(buf_feat8, buf_up8, 5, 6, 192, 128, 8, 8);
    groupnorm_ip(buf_feat8, 128, 8, 8, 16, 7, 8);
    linear_fwd(buf_film1, cond, 9, 10, 48, 256);
    film_apply(buf_feat8, buf_film1, 128, 8, 8); relu_ip(buf_feat8, 128 * 64);
    Serial.printf("[nn] s1: %lu ms\n", millis() - t0);

    upsample_2x(buf_up16, buf_feat8, 128, 8, 8);
    conv3x3_fast(buf_feat16, buf_up16, 11, 12, 128, 64, 16, 16);
    groupnorm_ip(buf_feat16, 64, 16, 16, 8, 13, 14);
    linear_fwd(buf_film2, cond, 15, 16, 48, 128);
    film_apply(buf_feat16, buf_film2, 64, 16, 16); relu_ip(buf_feat16, 64 * 256);
    Serial.printf("[nn] s2: %lu ms\n", millis() - t0);

    upsample_2x(buf_up32, buf_feat16, 64, 16, 16);
    conv3x3_fast(buf_feat32, buf_up32, 17, 18, 64, 32, 32, 32);
    groupnorm_ip(buf_feat32, 32, 32, 32, 8, 19, 20);
    linear_fwd(buf_film3, cond, 21, 22, 48, 64);
    film_apply(buf_feat32, buf_film3, 32, 32, 32); relu_ip(buf_feat32, 32 * 1024);
    Serial.printf("[nn] s3: %lu ms\n", millis() - t0);

    conv3x3_fast(buf_refined, buf_feat32, 23, 24, 32, 32, 32, 32);
    relu_ip(buf_refined, 32 * 1024);
    conv1x1_fast(buf_logits, buf_refined, 25, 26, 32, 24, 32, 32);
    argmax_ch(output_image, buf_logits, 24, 32, 32);

    Serial.printf("[nn] done: %lu ms\n", millis() - t0);
}

// keyword soup, good enough for ten classes
int text_to_class(const String& text) {
    String s = text; s.toLowerCase();
    if (s.indexOf("tshirt") >= 0 || s.indexOf("top") >= 0) return 0;
    if (s.indexOf("trouser") >= 0 || s.indexOf("pants") >= 0) return 1;
    if (s.indexOf("pullover") >= 0 || s.indexOf("sweater") >= 0) return 2;
    if (s.indexOf("dress") >= 0) return 3;
    if (s.indexOf("coat") >= 0 || s.indexOf("jacket") >= 0) return 4;
    if (s.indexOf("sandal") >= 0) return 5;
    if (s.indexOf("shirt") >= 0) return 6;
    if (s.indexOf("sneaker") >= 0 || s.indexOf("shoe") >= 0) return 7;
    if (s.indexOf("bag") >= 0) return 8;
    if (s.indexOf("boot") >= 0) return 9;
    return rng_next() % 10;   // didn't understand you? surprise me
}

// prototype * mix + gaussian * std. this is the entire "creativity" of the device
void get_latent(float* out, int cls) {
    for (int i = 0; i < 32; i++) {
        out[i] = Z_CLASS_MIX * get_w(27, cls * 32 + i) + Z_NOISE_STD * rng_gauss();
    }
}

// sits on core 0 forever, waits for the websocket to ask for a picture
void inferenceTask(void *pvParameters) {
    while (1) {
        if (want_image) {
            want_image = false;

            uint32_t seed = rng_seed();   // fresh hardware seed for every single image
            Serial.printf("[task] class %d | seed 0x%08X\n", wanted_class, seed);

            get_latent(z_vec, wanted_class);
            decoder_forward(out_img, z_vec, wanted_class);

            for (int i = 0; i < 1024; i++) sprintf(&hex_buf[i * 2], "%02X", out_img[i]);
            hex_buf[2048] = '\0';

            snprintf(json_buf, sizeof(json_buf),
                "{\"type\":\"image\",\"class\":%d,\"class_name\":\"%s\",\"width\":32,\"height\":32,\"data\":\"%s\"}",
                wanted_class, CLASS_NAMES[wanted_class], hex_buf);

            ws.textAll(json_buf);
            Serial.println("[task] sent.");
        }
        vTaskDelay(10 / portTICK_PERIOD_MS);
    }
}

// laziest json parser ever: just look for the word "generate" and pull the
// prompt out by hand. it's one fixed message shape from my own website, fine.
void onWsEvent(AsyncWebSocket* srv, AsyncWebSocketClient* client,
               AwsEventType type, void* arg, uint8_t* data, size_t len) {
    if (type == WS_EVT_CONNECT) {
        client->text("{\"type\":\"status\",\"message\":\"Connected!\"}");
    } else if (type == WS_EVT_DATA) {
        AwsFrameInfo* info = (AwsFrameInfo*)arg;
        if (info->final && info->index == 0 && info->len == len && info->opcode == WS_TEXT) {
            data[len] = 0;
            String msg = (char*)data;
            if (msg.indexOf("\"generate\"") >= 0) {
                if (!model_loaded) { client->text("{\"type\":\"error\",\"message\":\"No model\"}"); return; }
                int pStart = msg.indexOf("\"prompt\":\"") + 10;
                int pEnd = msg.indexOf("\"", pStart);
                String prompt = msg.substring(pStart, pEnd);
                int cls = text_to_class(prompt);
                client->text("{\"type\":\"status\",\"message\":\"Generating...\"}");
                wanted_class = cls;
                want_image = true;
            }
        }
    }
}

void setup() {
    Serial.begin(115200);
    delay(3000);   // usb-cdc needs a moment before it shows anything

    // the two lines that stopped the random mid-inference reboots:
    // brownout detector off (current spikes on cheap usb cables), and this
    // task off the watchdog (inference is long, the chip used to panic)
    WRITE_PERI_REG(RTC_CNTL_BROWN_OUT_REG, 0);
    esp_task_wdt_delete(xTaskGetCurrentTaskHandle());

    Serial.println("\n=== TinyGen ===");
    rng_seed();
    Serial.printf("[rng] boot seed 0x%08X | cpu %d MHz\n", last_seed, ESP.getCpuFreqMHz());

    if (!psramInit()) { Serial.println("no psram, no game."); while(1) delay(1000); }
    if (!SPIFFS.begin(true)) SPIFFS.format();   // first boot formats the partition
    model_loaded = SPIFFS.exists("/model_weights.bin") ? load_model() : false;
    if (!model_loaded) Serial.println("model_weights.bin missing or wrong - web ui will complain");

    if (model_loaded) {
        // ~900kb of activations, allocated once, never freed
        buf_feat4 = (float*)ps_malloc(3072*4); buf_up8 = (float*)ps_malloc(192*64*4);
        buf_feat8 = (float*)ps_malloc(128*64*4); buf_up16 = (float*)ps_malloc(128*256*4);
        buf_feat16 = (float*)ps_malloc(64*256*4); buf_up32 = (float*)ps_malloc(64*1024*4);
        buf_feat32 = (float*)ps_malloc(32*1024*4); buf_refined = (float*)ps_malloc(32*1024*4);
        buf_logits = (float*)ps_malloc(24*1024*4); buf_film1 = (float*)ps_malloc(256*4);
        buf_film2 = (float*)ps_malloc(128*4); buf_film3 = (float*)ps_malloc(64*4);
    }

    WiFi.mode(WIFI_STA);
    WiFi.setSleep(false);   // power save caused hiccups during long math, off
    WiFi.begin(WIFI_SSID, WIFI_PASS);
    while (WiFi.status() != WL_CONNECTED) { delay(500); Serial.print("."); }
    Serial.printf("\n[wifi] ip: %s\n", WiFi.localIP().toString().c_str());

    MDNS.begin(MDNS_NAME); MDNS.addService("http", "tcp", 80);
    ws.onEvent(onWsEvent); server.addHandler(&ws);
    server.on("/", HTTP_GET, [](AsyncWebServerRequest* r) { r->send(200, "text/html", INDEX_HTML); });
    server.begin();

    xTaskCreatePinnedToCore(inferenceTask, "InferenceTask", 16384, NULL, 1, NULL, 0);

    Serial.println("ready. open http://tinygen.local");
}

// nothing to do here, the inference task does all the work
void loop() { ws.cleanupClients(); delay(10); }